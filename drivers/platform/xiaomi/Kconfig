## drivers/platform/xiaomi/Kconfig
```kconfig
config MACH_XIAOMI_MSM8953
	bool "Xiaomi MSM8953"
	depends on ARCH_MSM8953
	help
	  Support for MSM8953 Xiaomi variants

menu "Xiaomi board selection"

config MACH_XIAOMI_TIFFANY
        bool "tiffany board"
        select MACH_XIAOMI_MSM8953
        help
          Support for MI 5X tiffany

config MACH_XIAOMI_VINCE
	bool "vince board"
	select MACH_XIAOMI_MSM8953
	help
	  Support for Redmi Note 5/Redmi 5 Plus vince

endmenu
```
